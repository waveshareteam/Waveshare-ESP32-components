## bsp/esp32_c6_touch_amoled_2_16/Kconfig
```kconfig
menu "Board Support Package"

    config BSP_ERROR_CHECK
        bool "Enable error check in BSP"
        default y
        help
            Assert on BSP errors instead of returning the error code.

    menu "I2C"
        config BSP_I2C_FAST_MODE
            bool "Enable I2C fast mode"
            default y
            help
                I2C has normal (100 kHz) and fast (400 kHz) modes.

        config BSP_I2C_CLK_SPEED_HZ
            int
            default 400000 if BSP_I2C_FAST_MODE
            default 100000
    endmenu

    menu "SPIFFS - Virtual File System"
        config BSP_SPIFFS_FORMAT_ON_MOUNT_FAIL
            bool "Format SPIFFS if mounting fails"
            default n

        config BSP_SPIFFS_MOUNT_POINT
            string "SPIFFS mount point"
            default "/spiffs"

        config BSP_SPIFFS_PARTITION_LABEL
            string "SPIFFS partition label"
            default "storage"

        config BSP_SPIFFS_MAX_FILES
            int "Maximum simultaneously open files"
            default 2
    endmenu

    menu "uSD card - Virtual File System"
        config BSP_SD_FORMAT_ON_MOUNT_FAIL
            bool "Format uSD card if mounting fails"
            default n

        config BSP_SD_MOUNT_POINT
            string "uSD card mount point"
            default "/sdcard"
    endmenu

    menu "Display"
        config BSP_DISPLAY_LVGL_BUF_HEIGHT
            int "LVGL buffer height"
            range 20 480
            default 100
            help
                Buffer width is the full 480-pixel display width.
    endmenu
endmenu
```

## bsp/esp32_s31_touch_lcd_4_3c/Kconfig
```kconfig
menu "Board Support Package (ESP32-S31-Touch-LCD-4.3C)"

    config BSP_ERROR_CHECK
        bool "Enable error check in BSP"
        default y
        help
            Error check asserts before returning the error code.

    menu "I2C"
        config BSP_I2C_NUM
            int "I2C peripheral index"
            default 0
            range 0 1
            help
                Pick the I2C peripheral used by the board peripherals.

        config BSP_I2C_FAST_MODE
            bool "Enable I2C fast mode"
            default y
            help
                I2C has two speed modes: standard (100 kHz) and fast (400 kHz).

        config BSP_I2C_CLK_SPEED_HZ
            int
            default 400000 if BSP_I2C_FAST_MODE
            default 100000
    endmenu

    menu "Storage"
        menu "SPIFFS - Virtual File System"
            config BSP_SPIFFS_FORMAT_ON_MOUNT_FAIL
                bool "Format SPIFFS if mounting fails"
                default n
                help
                    Format SPIFFS if it fails to mount the filesystem.

            config BSP_SPIFFS_MOUNT_POINT
                string "SPIFFS mount point"
                default "/spiffs"
                help
                    Mount point of SPIFFS in the Virtual File System.

            config BSP_SPIFFS_PARTITION_LABEL
                string "Partition label of SPIFFS"
                default "storage"
                help
                    Partition label which stores SPIFFS.

            config BSP_SPIFFS_MAX_FILES
                int "Max files supported for SPIFFS VFS"
                default 5
                help
                    Supported max files for SPIFFS in the Virtual File System.
        endmenu

        menu "SD card - Virtual File System"
            config BSP_SD_FORMAT_ON_MOUNT_FAIL
                bool "Format SD card if mounting fails"
                default n
                help
                    The SDMMC host formats the SD card if mounting fails.

            config BSP_SD_MOUNT_POINT
                string "SD card mount point"
                default "/sdcard"
                help
                    Mount point of the SD card in the Virtual File System.

            config BSP_SD_CTRL_ACTIVE_LOW
                bool "SD_CTRL is active low"
                default y
                help
                    GPIO56 is driven low while the SD card is enabled.
        endmenu
    endmenu

    menu "Display"
        config BSP_LCD_REFRESH_RATE_HZ
            int "LCD RGB refresh rate"
            default 60
            range 30 75
            help
                Target RGB LCD refresh rate in Hz. The BSP calculates PCLK from
                this value and the configured 800x480 porch values.

        config BSP_LCD_DRAW_BUF_HEIGHT
            int "LCD draw buffer height"
            default 100
            range 10 480
            help
                Draw buffer height used by the LVGL adapter.

        config BSP_LCD_RGB_BUFFER_NUMS
            int "RGB LCD frame buffer count"
            default 2
            range 1 3
            help
                Let the RGB LCD driver create the selected number of frame buffers.
                The default LVGL adapter RGB tearing mode uses two frame buffers.

        choice BSP_LCD_RGB_REFRESH_MODE
            prompt "Select RGB LCD refresh mode"
            default BSP_LCD_RGB_REFRESH_AUTO

            config BSP_LCD_RGB_REFRESH_AUTO
                bool "Auto refresh mode"

            config BSP_LCD_RGB_BOUNCE_BUFFER_MODE
                bool "Bounce buffer mode"
                help
                    Bounce buffer mode can allow a higher PCLK frequency with higher CPU usage.
        endchoice

        config BSP_LCD_RGB_BOUNCE_BUFFER_HEIGHT
            depends on BSP_LCD_RGB_BOUNCE_BUFFER_MODE
            int "Bounce buffer height"
            default 10
            help
                Height of each bounce buffer. Width is the LCD width.

        config BSP_DISPLAY_BRIGHTNESS_INVERTED
            bool "Backlight PWM is active low"
            default n
            help
                Invert the GPIO47 LEDC duty when the backlight input is active low.

        config BSP_DISPLAY_BRIGHTNESS_PWM_HZ
            int "Backlight PWM frequency"
            default 5000
            range 100 50000
            help
                PWM frequency used for the GPIO47 backlight control signal.

        config BSP_DISPLAY_BOOT_BRIGHTNESS_PERCENT
            int "Boot-time display brightness percent"
            default 0
            range 0 10
            help
                Keep the backlight dim while the RGB panel and LVGL/Brookesia
                UI are being initialized. Use 0 to keep the backlight off until
                the application explicitly raises it.

        config BSP_DISPLAY_DEFAULT_BRIGHTNESS_PERCENT
            int "Default display brightness percent"
            default 60
            range 0 100
            help
                Brightness applied by applications after display initialization
                is complete.

        config BSP_TOUCH_INIT_RETRY_COUNT
            int "GT911 touch init retry count"
            default 4
            range 1 8
            help
                Number of GT911 probe attempts. Failed attempts rerun the reset
                and address-selection sequence through GPIO46 and GPIO2.

        config BSP_TOUCH_INIT_RETRY_DELAY_MS
            int "GT911 touch init retry delay (ms)"
            default 120
            range 0 1000
            help
                Delay between GT911 probe attempts.

        config BSP_TOUCH_RESET_HOLD_MS
            int "GT911 reset hold time (ms)"
            default 50
            range 1 500
            help
                Time to keep TP_RESET asserted while TP_INT selects the GT911
                I2C address.

        config BSP_TOUCH_STARTUP_DELAY_MS
            int "GT911 startup delay after reset release (ms)"
            default 300
            range 50 1000
            help
                Time to wait after releasing TP_RESET before probing GT911.
    endmenu

    menu "Audio"
        config BSP_I2S_NUM
            int "I2S peripheral index"
            default 1
            range 0 2
            help
                Pick the I2S peripheral used by ES8389.
    endmenu

endmenu
```

## display/lcd/esp_lcd_hx8394/Kconfig
```kconfig
menu "ESP LCD HX8394 configuration"

    config ESP_LCD_HX8394_SKIP_I2C_INIT
        bool "Skip board-specific I2C initialization"
        default n
        help
            Skip the board-specific I2C bus setup and register sequence in the
            HX8394 panel constructor. Leave this disabled for backward-compatible
            standalone driver behavior. Enable it when the board BSP owns the
            required board-level I2C and power initialization.

endmenu
```
